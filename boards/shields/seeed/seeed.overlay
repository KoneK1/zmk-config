#include <dt-bindings/zmk/matrix_transform.h>

/ {
    chosen {
        zmk,kscan = &kscan0;
        zmk,matrix-transform = &default_transform;
    };

    kscan0: kscan0 {
        compatible = "zmk,kscan-gpio-direct";
        input-gpios =
            <&xiao_d 0 (GPIO_ACTIVE_LOW | GPIO_PULL_UP)>;
    };

    default_transform: matrix_transform {
        compatible = "zmk,matrix-transform";
        rows = <1>;
        columns = <1>;
        map = <RC(0,0)>;
    };
};