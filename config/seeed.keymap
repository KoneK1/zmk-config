#include <behaviors.dtsi>
#include <dt-bindings/zmk/keys.h>

/ {
    keymap {
        compatible = "zmk,keymap";

        base_layer {
            bindings = <
                &kp LS(LC(M))
            >;
        };
    };
};